## sdkconfig.defaults
```kconfig
CONFIG_IDF_TARGET="esp32s3"
CONFIG_ESPTOOLPY_FLASHMODE_QIO=y
CONFIG_ESPTOOLPY_FLASHFREQ_80M=y
CONFIG_ESPTOOLPY_FLASHSIZE_16MB=y
CONFIG_ESP32S3_DATA_CACHE_64KB=y
CONFIG_ESP32S3_DATA_CACHE_LINE_64B=y
CONFIG_SPIRAM=y
CONFIG_SPIRAM_MODE_OCT=y
CONFIG_SPIRAM_BOOT_INIT=y
CONFIG_SPIRAM_FETCH_INSTRUCTIONS=y
CONFIG_SPIRAM_RODATA=y
CONFIG_SPIRAM_MALLOC_ALWAYSINTERNAL=131072
CONFIG_SPIRAM_MALLOC_RESERVE_INTERNAL=196608
CONFIG_ESP32S3_RTCDATA_IN_FAST_MEM=n
CONFIG_ESP_SYSTEM_MEMPROT_FEATURE=n
CONFIG_PARTITION_TABLE_CUSTOM=y
CONFIG_PARTITION_TABLE_CUSTOM_FILENAME="partitions.csv"
CONFIG_PARTITION_TABLE_FILENAME="partitions.csv"
CONFIG_PARTITION_TABLE_OFFSET=0x8000
CONFIG_LOG_DEFAULT_LEVEL_INFO=y
CONFIG_FREERTOS_HZ=1000
CONFIG_FREERTOS_THREAD_LOCAL_STORAGE_POINTERS=4
CONFIG_FREERTOS_CHECK_STACKOVERFLOW_NONE=n
CONFIG_FREERTOS_CHECK_STACKOVERFLOW_PTRVAL=y
CONFIG_FREERTOS_IDLE_TASK_STACKSIZE=4096
CONFIG_ESP_MAIN_TASK_STACK_SIZE=12288
CONFIG_LIBC_STDOUT_LINE_ENDING_CRLF=y
CONFIG_LIBC_NEWLIB_NANO_FORMAT=n
CONFIG_ESP_MAIN_TASK_AFFINITY_CPU0=y
CONFIG_ESP_SLEEP_GPIO_RESET_WORKAROUND=y
CONFIG_ESP_CONSOLE_USB_SERIAL_JTAG=y
CONFIG_ESP_CONSOLE_SECONDARY_NONE=y
CONFIG_ESP_CONSOLE_UART_DEFAULT=n
CONFIG_HEAP_POISONING_DISABLED=n
CONFIG_ESP_WIFI_ENABLED=n
CONFIG_BT_ENABLED=n
CONFIG_COMPILER_OPTIMIZATION_SIZE=y
CONFIG_COMPILER_OPTIMIZATION_ASSERTIONS_DISABLE=y
CONFIG_LV_USE_BUILTIN_MALLOC=y
CONFIG_LV_MEM_SIZE_KILOBYTES=1024
CONFIG_LV_MEM_POOL_INCLUDE="app_config.h"
CONFIG_LV_MEM_POOL_ALLOC="app_lvgl_psram_alloc"
CONFIG_LV_USE_GRID=y
CONFIG_LV_USE_FLEX=y
CONFIG_LV_USE_FS_FATFS=y
CONFIG_LV_USE_LODEPNG=n
CONFIG_LV_USE_LIBPNG=n
CONFIG_LV_USE_BMP=n
CONFIG_LV_USE_GIF=n
CONFIG_LV_USE_TINY_TTF=n
CONFIG_LV_USE_SYSMON=y
CONFIG_LV_USE_PERF_MONITOR=y
CONFIG_LV_FONT_DEFAULT_MONTSERRAT_16=y
CONFIG_LV_FONT_MONTSERRAT_20=y
CONFIG_LV_FONT_MONTSERRAT_28=y
CONFIG_LV_COLOR_DEPTH_16=y
CONFIG_LV_DRAW_SW_COMPLEX=y
CONFIG_LV_USE_FREETYPE=n
CONFIG_LV_USE_THEME_DEFAULT=y
CONFIG_LV_THEME_DEFAULT_DARK=y
CONFIG_LV_USE_SNAPSHOT=y
CONFIG_LV_DRAW_BUF_STRIDE_ALIGN=64
CONFIG_LV_USE_LOG=y
CONFIG_LV_LOG_PRINTF=y
CONFIG_LV_LOG_LEVEL_INFO=y
CONFIG_TINYUSB_ENABLED=y
CONFIG_TINYUSB_USE_ROM_IMPL=y
CONFIG_TINYUSB_CDC_ENABLED=y
CONFIG_TINYUSB_MSC_ENABLED=n
CONFIG_TINYUSB_HID_ENABLED=n
CONFIG_TINYUSB_DFU_ENABLED=n
CONFIG_TINYUSB_CDC_RX_BUFSIZE=512
CONFIG_TINYUSB_CDC_TX_BUFSIZE=512
CONFIG_USB_OTG_SUPPORTED=y
CONFIG_TWAI_ISR_IN_IRAM=y
CONFIG_TWAI_ERRATA_FIX_LISTEN_ONLY_DOM=n
CONFIG_TWAI_ERRATA_FIX_BUS_OFF_REC=y
CONFIG_TWAI_ERRATA_FIX_TX_INTR_LOST=y
CONFIG_TWAI_ERRATA_FIX_RX_FIFO_CORRUPT=y
CONFIG_FATFS_LFN_HEAP=y
CONFIG_FATFS_MAX_LFN=255
CONFIG_FATFS_CODEPAGE_437=y
CONFIG_FATFS_PER_FILE_CACHE=y
CONFIG_FATFS_FS_LOCK=10
CONFIG_SPI_FLASH_ROM_DRIVER_PATCH=y
CONFIG_PTHREAD_TASK_PRIO_DEFAULT=5
CONFIG_PTHREAD_TASK_STACK_SIZE_DEFAULT=4096
CONFIG_PTHREAD_TASK_CORE_DEFAULT=-1
CONFIG_PTHREAD_STACK_MIN=2048
CONFIG_ESP_TASK_WDT_INIT=n
CONFIG_APPTRACE_DEST_NONE=y
CONFIG_ESP_COREDUMP_ENABLE_TO_NONE=y
CONFIG_PM_POWER_DOWN_CPU_IN_LIGHT_SLEEP=y
CONFIG_PM_RESTORE_CACHE_TAGMEM_AFTER_LIGHT_SLEEP=y
CONFIG_ESP_DEBUG_OCDAWARE=y
CONFIG_ADC_DISABLE_DAC=y
CONFIG_BOOTLOADER_COMPILER_OPTIMIZATION_SIZE=y
CONFIG_BOOTLOADER_VDDSDIO_BOOST_1_9V=y
CONFIG_BOOTLOADER_LOG_LEVEL_WARN=y
CONFIG_BOOTLOADER_REGION_PROTECTION_ENABLE=y
CONFIG_BOOTLOADER_WDT_ENABLE=y
CONFIG_BOOTLOADER_WDT_TIME_MS=9000
CONFIG_LWIP_LOCAL_HOSTNAME="jpg-viewer"
CONFIG_LWIP_MULTICAST_PING=n
CONFIG_LWIP_AUTOIP=n
CONFIG_LWIP_IPV6_AUTOCONFIG=n
CONFIG_LWIP_ESP_GRATUITOUS_ARP=y
CONFIG_LWIP_TCPIP_TASK_AFFINITY_CPU0=y
CONFIG_LWIP_TCPIP_TASK_STACK_SIZE=4096
CONFIG_ESP_PHY_CALIBRATION_AND_DATA_STORAGE=y
CONFIG_ESP_PHY_MAX_TX_POWER=20
CONFIG_ESP_COEX_SW_COEXIST_ENABLE=n
CONFIG_LOG_TIMESTAMP_SOURCE_RTOS=y
```
